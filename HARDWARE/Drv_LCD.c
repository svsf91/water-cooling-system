/**
  ******************************************************************************
  * @file    Drv_LCD.c
  * @author  彭澎(1252714)
  * @version V2.0
  * @date    2016/9/30
  * @brief   2.2'TFT LCD驱动源文件
  ******************************************************************************	
  * @attention
  * TFT_LED --> PD12
  * TFT_REST --> PD11
	*	TFT_CS --> FSMC_NE1(PD7)
	*	TFT_DB0 --> FSMC_D0(PD14)
	*	TFT_DB1 --> FSMC_D1(PD15)
	*	TFT_DB2 --> FSMC_D2(PD0)
	*	TFT_DB3 --> FSMC_D3(PD1)
	*	TFT_DB4 --> FSMC_D4(PE7)
	*	TFT_DB5 --> FSMC_D5(PE8)
	*	TFT_DB6 --> FSMC_D6(PE9)
	*	TFT_DB7 --> FSMC_D7(PE10)
	*	TFT_DB8 --> FSMC_D8(PE11)
	*	TFT_DB9 --> FSMC_D9(PE12)
	*	TFT_DB10 --> FSMC_D10(PE13)
	*	TFT_DB11 --> FSMC_D11(PE14)
	*	TFT_DB12 --> FSMC_D12(PE15)
	*	TFT_DB13 --> FSMC_D13(PD8)
	*	TFT_DB14 --> FSMC_D14(PD9)
	*	TFT_DB15 --> FSMC_D15(PD10)
	*	TFT_RS --> FSMC_A18(PD13)
	*	TFT_RD --> FSMC_NOE(PD4)
	*	TFT_WR --> FSMC_NWE(PD5)
	*
	*	本库支持FSMC驱动和软件模拟8080并口驱动
	* 使用FSMC驱动请添加宏定义“#define LCD_USE_FSMC"，否则使用软件模拟8080并口驱动
	* FSMC驱动效率最高，但FSMC会与TIM4_CH2(PB7)管脚发生冲突，以至于该管脚不能用于输出PWM信号
	* 如需使用TIM4_CH2(PB7)输出PWM信号，请选择软件模拟8080并口驱动LCD
	*
	* 使用本库需要实现毫秒级延时函数 "void Delay_Ms(uint32_t nms)"
  ******************************************************************************			
  */ 
	
#include "Drv_LCD.h"

/*8X16像素ASCII字符点阵数据*/
const uint8_t ascii_8X16[95][16] = 
{
	{0x00,0x00,0x00,0x00,0x00,0x00,0x00,0x00,0x00,0x00,0x00,0x00,0x00,0x00,0x00,0x00},/*" ",0*/
	{0x00,0x00,0x00,0x08,0x08,0x08,0x08,0x08,0x08,0x08,0x00,0x00,0x08,0x08,0x00,0x00},/*"!",1*/
	{0x00,0x48,0x24,0x24,0x12,0x00,0x00,0x00,0x00,0x00,0x00,0x00,0x00,0x00,0x00,0x00},/*""",2*/
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	{0x04,0x5A,0x20,0x00,0x00,0x00,0x00,0x00,0x00,0x00,0x00,0x00,0x00,0x00,0x00,0x00},/*"~",94*/
};

/*176x176像素同济校徽点阵数据*/
const uint8_t tongji_logo[176][22] = 
{
	{0x00,0x00,0x00,0x00,0x00,0x00,0x00,0x00,0x00,0x00,0xF8,0x1F,0x00,0x00,0x00,0x00,0x00,0x00,0x00,0x00,0x00,0x00},
	{0x00,0x00,0x00,0x00,0x00,0x00,0x00,0x00,0x00,0xFC,0xFF,0xFF,0x3F,0x00,0x00,0x00,0x00,0x00,0x00,0x00,0x00,0x00},
	{0x00,0x00,0x00,0x00,0x00,0x00,0x00,0x00,0xF0,0xFF,0xFF,0xFF,0xFF,0x0F,0x00,0x00,0x00,0x00,0x00,0x00,0x00,0x00},
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	{0x00,0x00,0x00,0x00,0x00,0x00,0x00,0x00,0x00,0x00,0xFE,0x7F,0x00,0x00,0x00,0x00,0x00,0x00,0x00,0x00,0x00,0x00},
};

/*全局变量*/
uint16_t point_color = BLACK;

/**
* @brief  LCD写寄存器函数
* @param  reg_addr:寄存器地址
*         reg_value:要写入的值
* @retval 无
*/
static inline void LCD_WriteReg(uint16_t reg_addr,uint16_t reg_value)
{
	LCD_WR_CMD(reg_addr);
	LCD_WR_DATA(reg_value);
}

#ifdef LCD_USE_FSMC

/**
* @brief  LCD读寄存器函数
* @param  reg_addr:寄存器地址
* @retval 从寄存器读出的值
*/
static inline uint16_t LCD_ReadReg(uint8_t reg_addr)
{
	LCD_WR_CMD(reg_addr);
	Delay_Us(5);
	return LCD_RD_DATA;
}

#endif /* LCD_USE_FSMC */

/**
* @brief  LCD初始化函数
* @param  无
* @retval 无
*/
void LCD_Init(void)
{
	#ifdef LCD_USE_FSMC
	
	/*开启GPIOD,GPIOE,FSMC外设时钟*/
	RCC_APB2PeriphClockCmd(RCC_APB2Periph_GPIOD,ENABLE);
	RCC_APB2PeriphClockCmd(RCC_APB2Periph_GPIOE,ENABLE);
	RCC_AHBPeriphClockCmd(RCC_AHBPeriph_FSMC,ENABLE);
	
	/*设置GPIO管脚工作模式*/
	GPIO_InitTypeDef GPIO_InitStructure;
	GPIO_InitStructure.GPIO_Speed = GPIO_Speed_50MHz;                             //最大工作频率50MHz
	GPIO_InitStructure.GPIO_Mode = GPIO_Mode_Out_PP;                              //通用推挽输出
	GPIO_InitStructure.GPIO_Pin = GPIO_Pin_11|GPIO_Pin_12;                        //TFT_LED和TFT_REST
	GPIO_Init(GPIOD,&GPIO_InitStructure);                                         
	GPIO_InitStructure.GPIO_Mode = GPIO_Mode_AF_PP;                               //复用推挽输出
	GPIO_InitStructure.GPIO_Pin = GPIO_Pin_0|GPIO_Pin_1|  \
	                              GPIO_Pin_4|GPIO_Pin_5|GPIO_Pin_7|  \
	                              GPIO_Pin_8|GPIO_Pin_9|GPIO_Pin_10|  \
	                              GPIO_Pin_13|GPIO_Pin_14|GPIO_Pin_15;            //TFT_DB2,TFT_DB3,TFT_RD,TFT_WR,TFT_CS,TFT_DB13,TFT_DB14,TFT_DB15,TFT_RS,TFT_DB0,TFT_DB1
	GPIO_Init(GPIOD,&GPIO_InitStructure);                                         
	GPIO_InitStructure.GPIO_Pin = GPIO_Pin_7|GPIO_Pin_8|GPIO_Pin_9|  \
	                              GPIO_Pin_10|GPIO_Pin_11|GPIO_Pin_12|  \
																GPIO_Pin_13|GPIO_Pin_14|GPIO_Pin_15;            //TFT_DB[4:12] 
  GPIO_Init(GPIOE,&GPIO_InitStructure);    
	                                                                              
	/*配置FSMC读时序参数*/                                                        
	FSMC_NORSRAMTimingInitTypeDef FSMC_ReadWriteTimingStructure;                  
	FSMC_ReadWriteTimingStructure.FSMC_AddressSetupTime = 1;                      //地址信号建立时间2个HCLK周期
	FSMC_ReadWriteTimingStructure.FSMC_AddressHoldTime = 0;
	FSMC_ReadWriteTimingStructure.FSMC_DataSetupTime = 15;                        //数据信号建立时间16个HCLK周期
	FSMC_ReadWriteTimingStructure.FSMC_BusTurnAroundDuration = 0;
	FSMC_ReadWriteTimingStructure.FSMC_CLKDivision = 0;
	FSMC_ReadWriteTimingStructure.FSMC_DataLatency = 0;
	FSMC_ReadWriteTimingStructure.FSMC_AccessMode = FSMC_AccessMode_A;            //异步访问模式A
	                                                                              
	/*配置FSMC写时序参数*/                                                        
	FSMC_NORSRAMTimingInitTypeDef FSMC_WriteTimingStructure;                      
	FSMC_WriteTimingStructure.FSMC_AddressSetupTime = 0;                          //地址信号建立时间1个HCLK周期
	FSMC_WriteTimingStructure.FSMC_AddressHoldTime = 0;
	FSMC_WriteTimingStructure.FSMC_DataSetupTime = 3;                             //数据信号建立时间4个HCLK周期
	FSMC_WriteTimingStructure.FSMC_BusTurnAroundDuration = 0;
	FSMC_WriteTimingStructure.FSMC_CLKDivision = 0;
	FSMC_WriteTimingStructure.FSMC_DataLatency = 0;
	FSMC_WriteTimingStructure.FSMC_AccessMode = FSMC_AccessMode_A;                //异步访问模式A
	                                                                              
	/*配置FSMC工作参数*/  
	FSMC_NORSRAMInitTypeDef FSMC_NORSRAMIintStructure;                            
	FSMC_NORSRAMIintStructure.FSMC_Bank = FSMC_Bank1_NORSRAM1;                    //LCD_CS连接到FSMC_NE1，因此这里选存储块1
	FSMC_NORSRAMIintStructure.FSMC_DataAddressMux = FSMC_DataAddressMux_Disable;  //地址线与数据线不复用
	FSMC_NORSRAMIintStructure.FSMC_MemoryType = FSMC_MemoryType_SRAM;             //将LCD当作SRAM来处理
	FSMC_NORSRAMIintStructure.FSMC_MemoryDataWidth = FSMC_MemoryDataWidth_16b;    //数据线宽度16位
	FSMC_NORSRAMIintStructure.FSMC_BurstAccessMode = FSMC_BurstAccessMode_Disable;
	FSMC_NORSRAMIintStructure.FSMC_WaitSignalPolarity = FSMC_WaitSignalPolarity_Low;
	FSMC_NORSRAMIintStructure.FSMC_AsynchronousWait = FSMC_AsynchronousWait_Disable;
	FSMC_NORSRAMIintStructure.FSMC_WrapMode = FSMC_WrapMode_Disable;
	FSMC_NORSRAMIintStructure.FSMC_WaitSignalActive = FSMC_WaitSignalActive_BeforeWaitState;
	FSMC_NORSRAMIintStructure.FSMC_WriteOperation = FSMC_WriteOperation_Enable;   //写操作使能
	FSMC_NORSRAMIintStructure.FSMC_WaitSignal = FSMC_WaitSignal_Disable;
	FSMC_NORSRAMIintStructure.FSMC_ExtendedMode = FSMC_ExtendedMode_Enable;       //读写采用不同时序
	FSMC_NORSRAMIintStructure.FSMC_WriteBurst = FSMC_WriteBurst_Disable;
	FSMC_NORSRAMIintStructure.FSMC_ReadWriteTimingStruct = &FSMC_ReadWriteTimingStructure;
	FSMC_NORSRAMIintStructure.FSMC_WriteTimingStruct = &FSMC_WriteTimingStructure;
	FSMC_NORSRAMInit(&FSMC_NORSRAMIintStructure);
	
	/*使能BANK1的存储块1*/
	FSMC_NORSRAMCmd(FSMC_Bank1_NORSRAM1,ENABLE);
	
	/*调用一次，防止警告，没有实际意义*/
	LCD_ReadReg(0x00);
	
	#else /* LCD_USE_FSMC */
	
	/*开启GPIOD,GPIOE,GPIOG外设时钟*/
	RCC_APB2PeriphClockCmd(RCC_APB2Periph_GPIOD,ENABLE);
	RCC_APB2PeriphClockCmd(RCC_APB2Periph_GPIOE,ENABLE);
	
	/*设置GPIO管脚工作模式*/
	GPIO_InitTypeDef GPIO_InitStructure;
	GPIO_InitStructure.GPIO_Speed = GPIO_Speed_50MHz;                             //最大工作频率50MHz
	GPIO_InitStructure.GPIO_Mode = GPIO_Mode_Out_PP;                              //通用推挽输出
	GPIO_InitStructure.GPIO_Pin = GPIO_Pin_11|GPIO_Pin_12;                        //TFT_LED和TFT_REST
	GPIO_Init(GPIOD,&GPIO_InitStructure);                                         
	GPIO_InitStructure.GPIO_Pin = GPIO_Pin_0|GPIO_Pin_1|  \
	                              GPIO_Pin_4|GPIO_Pin_5|GPIO_Pin_7|  \
	                              GPIO_Pin_8|GPIO_Pin_9|GPIO_Pin_10|  \
	                              GPIO_Pin_13|GPIO_Pin_14|GPIO_Pin_15;           //TFT_DB2,TFT_DB3,TFT_RD,TFT_WR,TFT_CS,TFT_DB13,TFT_DB14,TFT_DB15,TFT_RS,TFT_DB0,TFT_DB1
	GPIO_Init(GPIOD,&GPIO_InitStructure);                                         
	GPIO_InitStructure.GPIO_Pin = GPIO_Pin_7|GPIO_Pin_8|GPIO_Pin_9|  \
	                              GPIO_Pin_10|GPIO_Pin_11|GPIO_Pin_12|  \
																GPIO_Pin_13|GPIO_Pin_14|GPIO_Pin_15;            //TFT_DB[4:12]
	GPIO_Init(GPIOE,&GPIO_InitStructure);                                                                            
	
	LCD_RD_HIGH;
	
	#endif /* LCD_USE_FSMC */
	
	/*复位LCD*/
	LCD_REST_HIGH;
	Delay_Ms(10);
	LCD_REST_LOW;
	Delay_Ms(10);
	LCD_REST_HIGH;
	
	/*LCD初始化序列*/
	LCD_WriteReg(0x11,0x001A);
	LCD_WriteReg(0x12,0x3121);
	LCD_WriteReg(0x13,0x006C);
	LCD_WriteReg(0x14,0x4249);
	LCD_WriteReg(0x10,0x0800);
	Delay_Ms(10);
	LCD_WriteReg(0x11,0x011A);
	Delay_Ms(10);
	LCD_WriteReg(0x11,0x031A);
	Delay_Ms(10);
	LCD_WriteReg(0x11,0x071A);
	Delay_Ms(10);
	LCD_WriteReg(0x11,0x0F1A);
	Delay_Ms(20);
	LCD_WriteReg(0x11,0x0F3A);
	Delay_Ms(30);
	LCD_WriteReg(0x01,0x011C);
	LCD_WriteReg(0x02,0x0100);
	LCD_WriteReg(0x03,0x1030);
	LCD_WriteReg(0x07,0x0000);
	LCD_WriteReg(0x08,0x0808);
	LCD_WriteReg(0x0B,0x1100);
	LCD_WriteReg(0x0C,0x0000);
	LCD_WriteReg(0x0F,0x1401);
	LCD_WriteReg(0x15,0x0000);
	LCD_WriteReg(0x20,0x0000);
	LCD_WriteReg(0x21,0x0000);
	LCD_WriteReg(0x38,0x00DB);
	LCD_WriteReg(0x39,0x0000);
	LCD_WriteReg(0x50,0x0001);
	LCD_WriteReg(0x51,0x020B);
	LCD_WriteReg(0x52,0x0805);
	LCD_WriteReg(0x53,0x0404);
	LCD_WriteReg(0x54,0x0C0C);
	LCD_WriteReg(0x55,0x000C);
	LCD_WriteReg(0x56,0x0101);
	LCD_WriteReg(0x57,0x0400);
	LCD_WriteReg(0x58,0x1108);
	LCD_WriteReg(0x59,0x050C);
	LCD_WriteReg(0x36,0x00AF);
	LCD_WriteReg(0x37,0x0000);
	LCD_WriteReg(0x38,0x00DB);
	LCD_WriteReg(0x39,0x0000);
	LCD_WriteReg(0x0F,0x0B01);
	LCD_WriteReg(0x07,0x0016);
	Delay_Ms(2);
	LCD_WriteReg(0x07,0x0017);
	LCD_WR_CMD(0x22);
	Delay_Ms(10);
	
	/*点亮背光*/
	LCD_LED_ON;
	
	/*清屏*/
	LCD_Clear(WHITE);
}

/**
* @brief  LCD显示窗口设置函数
* @param  x1,y1:窗口左上角坐标
*         x2,y2:窗口右下角坐标
* @retval 无
*/	
void LCD_Window(uint8_t x1,uint8_t y1,uint8_t x2,uint8_t y2)
{
	LCD_WriteReg(0x37,x1);
	LCD_WriteReg(0x36,x2);
	LCD_WriteReg(0x39,y1);
	LCD_WriteReg(0x38,y2);
	
	LCD_WriteReg(0x20,x1);
	LCD_WriteReg(0x21,y1);
	
	LCD_WR_CMD(0x22);
}

/**
* @brief  LCD清屏函数
* @param  color:背景颜色
* @retval 无
*/
void LCD_Clear(uint16_t color)
{
	/*设置坐标*/
	LCD_Window(0,0,LCD_W-1,LCD_H-1);
	
	/*写入数据*/
	for(uint8_t i=0;i<LCD_W;i++)
		for(uint8_t j=0;j<LCD_H;j++)
			LCD_WR_DATA(color);
}

void LCD_Clear_Draw(uint16_t color)
{
	/*设置坐标*/
	LCD_Window(0,0,LCD_W-1,179);
	
	/*写入数据*/
	for(uint8_t i=0;i<LCD_W;i++)
		for(uint8_t j=0;j<LCD_H;j++)
			LCD_WR_DATA(color);
}
//clear line by LCD_printf("      ")
//void LCD_Clear_line(uint16_t color,uint8_t line)	
//{
//	LCD_Window(0,0,LCD_W-1,LCD_H-1);
//	for(uint8_t i=0;i<LCD_W;i++)
//		for(uint8_t j=0;j<LCD_H;j++)
//			LCD_WR_DATA(color);
//	
//	LCD_Window(0,0,LCD_W-1,LCD_H-1);
//}
/**
* @brief  LCD绘制图片函数
* @param  drawBitmapStructure:一个LCD_DrawBitmapTypeDef类型的结构体指针
* @retval 无
*/
void LCD_DrawBitmap(LCD_DrawBitmapTypeDef *structure)
{
	/*检查参数合法性*/
	assert_param(structure->start_x < LCD_W || structure->start_y < LCD_H);
	assert_param(structure->start_x + structure->width <= LCD_W);
	assert_param(structure->start_y + structure->height <= LCD_H);
	
	/*设置坐标*/
	LCD_Window(structure->start_x,structure->start_y,structure->start_x+structure->width-1,structure->start_y+structure->height-1);
	
	/*写入数据*/
	for(uint16_t i = 0;i < (structure->height*structure->width/8);i++)
		for(uint8_t j = 0;j < 8;j++)
			(*(structure->pBitmapData + i)&(1<<j)) ? (LCD_WR_DATA(structure->color)) : (LCD_WR_DATA(WHITE));
}

/**
* @brief  LCD画点函数
* @param  x：点的横坐标
          y：点的纵坐标
          color：点的颜色
* @retval 无
*/
void LCD_DrawPoint(uint8_t x,uint8_t y)
{
	/*检查参数合法性*/
	assert_param(x < LCD_W || y < LCD_H);
	
	/*设置坐标*/
	LCD_Window(x,y,x,y);
	
	/*写入数据*/
	LCD_WR_DATA(point_color);
}

/**
* @brief  LCD显示字符函数
* @param  x：字符起始横坐标
          y：字符起始纵坐标
          color：字符的颜色
          ch：字符的ASCII码
* @retval 无
*/
void LCD_ShowChar(uint8_t x,uint8_t y,uint8_t ch)
{
	/*检查参数合法性*/
	assert_param(x < LCD_W-8 || y < LCD_H-16);
	
	uint8_t temp;
	
	/*设置窗口*/
	LCD_Window(x,y,x+7,y+15);
	
	/*写入数据*/
	for(uint8_t i = 0;i < 16;i++)
	{
		temp = ascii_8X16[ch-32][i];
		for(uint8_t j = 0;j < 8;j++)
		{
			if(temp & (1<<j))
			{
				LCD_WR_DATA(point_color);
			}
			else
			{
				LCD_WR_DATA(WHITE);
			}
		}
	}
}

uint8_t px = 0,py = 0;

/**
* @brief  设置格式化打印起始坐标函数
* @param  start_x:打印起始横坐标，范围0-167
*         start_y:打印起始纵坐标，范围0-212
* @retval 无
*/
void LCD_SetStart(uint8_t start_x,uint8_t start_y)
{
	/*检查参数合法性*/
	assert_param(start_x < LCD_W-8 || start_y < LCD_H-16);
	
	px = start_x;
	py = start_y;
}

/**
* @brief  LCD的格式化打印函数
* @param  与标准printf函数用法相同
* @retval 无
*/
#define CMD_BUFFER_LEN 128
void LCD_printf(char *fmt, ...)
{
	char buffer[CMD_BUFFER_LEN+1];
	uint8_t i = 0;
	
	va_list arg_ptr;
	va_start(arg_ptr,fmt);
	vsnprintf(buffer,CMD_BUFFER_LEN+1,fmt,arg_ptr);
	while((i < CMD_BUFFER_LEN) && buffer[i])
	{
		if(px > LCD_W-8)
		{
			px = 0;
			py += 16;
		}
		if(py > LCD_H-16)
		{
			px = 0;
			py = 0;
		}
		
		if(buffer[i] == '\n')
		{
			px = 0;
			py += 16;
			i++;
		}
		else if(buffer[i] == '\f')
		{
			px = 0;
			py = 0;
			i++;
		}
		else
		{
			LCD_ShowChar(px,py,buffer[i++]);
			px += 8;
		}
	}
	va_end(arg_ptr);
}
